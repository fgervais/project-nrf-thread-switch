## west.yml
```yaml
manifest:
  remotes:
    - name: ncs
      url-base: https://github.com/nrfconnect
  projects:
    - name: nrf
      repo-path: sdk-nrf
      remote: ncs
      revision: v2.7.0
      import: true
    - name: zephyr-my-boards
      url: https://github.com/fgervais/zephyr-my-boards
      revision: b0c946a493c6264f263f24b125698062808d2e8b
      path: myboards
    - name: zephyr-mymodule-base
      url: https://github.com/fgervais/zephyr-mymodule-base.git
      revision: 7f3081dc19a1fb15a7f2f05d2c7fd07322f4ac3d
      path: mymodules/base
  self:
    path: application
```
